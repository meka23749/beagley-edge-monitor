## meta-beagley-monitor/conf/layer.conf
```bitbake
BBPATH .= ":${LAYERDIR}"

BBFILES += "${LAYERDIR}/recipes-*/*/*.bb \
            ${LAYERDIR}/recipes-*/*/*.bbappend"

BBFILE_COLLECTIONS += "meta-beagley-monitor"
BBFILE_PATTERN_meta-beagley-monitor = "^${LAYERDIR}/"
BBFILE_PRIORITY_meta-beagley-monitor = "6"

LAYERDEPENDS_meta-beagley-monitor = "core"
LAYERSERIES_COMPAT_meta-beagley-monitor = "scarthgap"
```
